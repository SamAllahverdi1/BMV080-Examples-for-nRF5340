## boards/arm/yaptic/Kconfig.yaptic
```kconfig
# Copyright (c) 2022 Zephyr Project members and individual contributors
# SPDX-License-Identifier: Apache-2.0

config BOARD_YAPTIC
	select SOC_NRF5340_CPUAPP_QKAA if BOARD_YAPTIC_NRF5340_CPUAPP
	select SOC_NRF5340_CPUAPP_QKAA if BOARD_YAPTIC_NRF5340_CPUAPP_NS
	select SOC_NRF5340_CPUNET_QKAA if BOARD_YAPTIC_NRF5340_CPUNET
```

## boards/arm/yaptic/board.yml
```yaml
board:
  name: yaptic
  vendor: nordic
  socs:
  - name: 'nrf5340'
    variants:
    - name: 'ns'
      cpucluster: 'cpuapp'
```

## build/Kconfig/Kconfig.shield
```kconfig
osource "c:/users/samal/onedrive/documents/github/simple-bmv080-connection/boards/shields/*/Kconfig.shield"
osource "C:/Users/samal/OneDrive/Documents/GitHub/simple-bmv080-connection/boards/shields/*/Kconfig.shield"
osource "C:/ncs/v3.1.0/nrf/boards/shields/*/Kconfig.shield"
```

## build/Kconfig/boards/Kconfig.sysbuild
```kconfig
# Load Sysbuild board Kconfig descriptions.
osource "C:/Users/samal/OneDrive/Documents/GitHub/simple-bmv080-connection/boards/arm/yaptic/Kconfig.sysbuild"
```
